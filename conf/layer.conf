## conf/layer.conf
```bitbake
# We have a conf and classes directory, add to BBPATH
BBPATH .= ":${LAYERDIR}"

# We have recipes-* directories, add to BBFILES
BBFILES += "${LAYERDIR}/recipes-*/*/*.bb \
	${LAYERDIR}/recipes-*/*/*.bbappend"

BBFILE_COLLECTIONS += "meta-virt-gpu-native"
BBFILE_PATTERN_meta-virt-gpu-native = "^${LAYERDIR}/"
BBFILE_PRIORITY_meta-virt-gpu-native = "6"
```
